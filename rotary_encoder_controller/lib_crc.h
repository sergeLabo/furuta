#ifndef lib_crc_h
#define lib_crc_h

#include <Arduino.h>

namespace libcrc {
        
    #define CRC16_INITIAL_VALUE 0x0000
    #define CRC16_SHIFTER 0x00FF

    static const uint8_t crc8_table[256] = {
        0x00, 0x07, 0x0e, 0x09, 0x1c, 0x1b, 0x12, 0x15, 0x38, 0x3f, 0x36, 0x31,
        0x24, 0x23, 0x2a, 0x2d, 0x70, 0x77, 0x7e, 0x79, 0x6c, 0x6b, 0x62, 0x65,
        0x48, 0x4f, 0x46, 0x41, 0x54, 0x53, 0x5a, 0x5d, 0xe0, 0xe7, 0xee, 0xe9,
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        0xfa, 0xfd, 0xf4, 0xf3
    };

    /*
    static const uint8_t crc8_cdma2000_table[256] = {
        0x00, 0x9b, 0xad, 0x36, 0xc1, 0x5a, 0x6c, 0xf7, 0x19, 0x82, 0xb4, 0x2f, 
        0xd8, 0x43, 0x75, 0xee, 0x32, 0xa9, 0x9f, 0x04, 0xf3, 0x68, 0x5e, 0xc5, 
        0x2b, 0xb0, 0x86, 0x1d, 0xea, 0x71, 0x47, 0xdc, 0x64, 0xff, 0xc9, 0x52, 
        0xa5, 0x3e, 0x08, 0x93, 0x7d, 0xe6, 0xd0, 0x4b, 0xbc, 0x27, 0x11, 0x8a, 
        0x56, 0xcd, 0xfb, 0x60, 0x97, 0x0c, 0x3a, 0xa1, 0x4f, 0xd4, 0xe2, 0x79, 
        0x8e, 0x15, 0x23, 0xb8, 0xc8, 0x53, 0x65, 0xfe, 0x09, 0x92, 0xa4, 0x3f, 
        0xd1, 0x4a, 0x7c, 0xe7, 0x10, 0x8b, 0xbd, 0x26, 0xfa, 0x61, 0x57, 0xcc, 
        0x3b, 0xa0, 0x96, 0x0d, 0xe3, 0x78, 0x4e, 0xd5, 0x22, 0xb9, 0x8f, 0x14, 
        0xac, 0x37, 0x01, 0x9a, 0x6d, 0xf6, 0xc0, 0x5b, 0xb5, 0x2e, 0x18, 0x83, 
        0x74, 0xef, 0xd9, 0x42, 0x9e, 0x05, 0x33, 0xa8, 0x5f, 0xc4, 0xf2, 0x69, 
        0x87, 0x1c, 0x2a, 0xb1, 0x46, 0xdd, 0xeb, 0x70, 0x0b, 0x90, 0xa6, 0x3d, 
        0xca, 0x51, 0x67, 0xfc, 0x12, 0x89, 0xbf, 0x24, 0xd3, 0x48, 0x7e, 0xe5, 
        0x39, 0xa2, 0x94, 0x0f, 0xf8, 0x63, 0x55, 0xce, 0x20, 0xbb, 0x8d, 0x16, 
        0xe1, 0x7a, 0x4c, 0xd7, 0x6f, 0xf4, 0xc2, 0x59, 0xae, 0x35, 0x03, 0x98, 
        0x76, 0xed, 0xdb, 0x40, 0xb7, 0x2c, 0x1a, 0x81, 0x5d, 0xc6, 0xf0, 0x6b, 
        0x9c, 0x07, 0x31, 0xaa, 0x44, 0xdf, 0xe9, 0x72, 0x85, 0x1e, 0x28, 0xb3, 
        0xc3, 0x58, 0x6e, 0xf5, 0x02, 0x99, 0xaf, 0x34, 0xda, 0x41, 0x77, 0xec, 
        0x1b, 0x80, 0xb6, 0x2d, 0xf1, 0x6a, 0x5c, 0xc7, 0x30, 0xab, 0x9d, 0x06, 
        0xe8, 0x73, 0x45, 0xde, 0x29, 0xb2, 0x84, 0x1f, 0xa7, 0x3c, 0x0a, 0x91, 
        0x66, 0xfd, 0xcb, 0x50, 0xbe, 0x25, 0x13, 0x88, 0x7f, 0xe4, 0xd2, 0x49, 
        0x95, 0x0e, 0x38, 0xa3, 0x54, 0xcf, 0xf9, 0x62, 0x8c, 0x17, 0x21, 0xba, 
        0x4d, 0xd6, 0xe0, 0x7b
    };
    */

    static const uint16_t crc16_table[256] = {
        0x0000, 0x1021, 0x2042, 0x3063, 0x4084, 0x50a5, 0x60c6, 0x70e7, 
        0x8108, 0x9129, 0xa14a, 0xb16b, 0xc18c, 0xd1ad, 0xe1ce, 0xf1ef, 
        0x1231, 0x0210, 0x3273, 0x2252, 0x52b5, 0x4294, 0x72f7, 0x62d6, 
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        0x6e17, 0x7e36, 0x4e55, 0x5e74, 0x2e93, 0x3eb2, 0x0ed1, 0x1ef0
    };

    // FIXME: This CRC8 return 0 for a buffer full of 0 so it is valid for an empty transmission which is bad.
    uint8_t crc8(uint8_t *p, size_t len) {
        uint16_t i;
        uint16_t crc = 0x0;

        while (len --) {
                i = (crc ^ *p++) & 0xFF;
                crc = (crc8_table[i] ^ (crc << 8)) & 0xFF;
        }

        return crc & 0xFF;
    }

    uint16_t xmodemCrc16(uint8_t *buf, int length) {
        uint16_t crc = CRC16_INITIAL_VALUE;
        for(int i = 0; i < length; i++) {
            uint16_t  tableValue = crc16_table[((crc >> 8) ^ *(uint8_t*)buf++) & CRC16_SHIFTER];
            crc = (crc << 8) ^ tableValue;
        }
    
        return crc;
    }

    // This uses CRC16-CCITT
    // From: http://arduino.cc/forum/index.php/topic,96539.0.html
    // This data is from
    // http://forum.arduino.cc/index.php?topic=529288.0
    // See bottom of this page: http://www.nongnu.org/avr-libc/user-manual/group__util__crc.html
    // Polynomial: x^16 + x^12 + x^5 + 1 (0x1021)
    uint16_t crc16XmodemUpdate (uint16_t crc, uint8_t data) {
        int i;
        crc = crc ^ ((uint16_t)data << 8);
        for (i=0; i<8; i++) {
            if (crc & 0x8000)
            crc = (crc << 1) ^ 0x1021; //(polynomial = 0x1021)
            else
            crc <<= 1;
        }
        return crc;
    }

    uint16_t slowXmodemCrc16(uint8_t *msg, size_t n) {
        // Initial value. xmodem uses 0xFFFF but this example
        // requires an initial value of zero.
        uint16_t x = 0;
        while(n--) {
            x = crc16XmodemUpdate(x, (uint16_t)*msg++);
        }
        return(x);
    }

    uint16_t crc16(uint8_t *buf, int length) {
        return xmodemCrc16(buf, length);
    }

    void markCrc8(uint8_t *data, size_t length) {
        uint8_t crc = crc8(&data[1], length - 1);
        data[0] = crc;
    }

    void markCrc16(uint8_t *data, size_t length) {
        uint16_t crc = crc16(&data[2], length - 2);
        data[0] = crc >> 8;
        data[1] = crc;
    }

    bool checkCrc8(uint8_t *data, size_t length) {
        // CRC8 at first position
        uint8_t received = data[0];
        // Serial.printf("Validating CRC8 with length: %d ...\n", length);
        uint8_t calculated = crc8(&data[1], length - 1);
        if (received != calculated) {
            #ifdef LOG_WARN
            Serial.printf("CRC8 NOT VALID !!! expected: %d but got: %d for length: %d\n", received, calculated, length);
            #endif
            return false;
        }
        //Serial.printf("CRC8 IS VALID\n");
        return true;
    }

    bool checkCrc16(uint8_t *data, size_t length) {
        // CRC16 at first position
        uint16_t received = (uint16_t) data[0];
        received = received << 8;
        received += (uint16_t) data[1];
        // Serial.printf("Validating CRC16 with length: %d ...\n", length);
        uint16_t calculated = crc16(&data[2], length - 2);
        if (received != calculated) {
            #ifdef LOG_WARN
            Serial.printf("CRC16 NOT VALID !!! expected: %d but got: %d for length: %d\n", received, calculated, length);
            #endif
            return false;
        }
        //Serial.printf("CRC16 IS VALID\n");
        return true;
    }
}

#endif